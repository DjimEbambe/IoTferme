## edge-device-stack/esp32/device-pzem/sdkconfig.defaults
```kconfig
CONFIG_IDF_TARGET="esp32s3"
CONFIG_FREERTOS_HZ=1000
CONFIG_COMPILER_OPTIMIZATION_SIZE=y
CONFIG_ESP_DEFAULT_CPU_FREQ_MHZ=240
CONFIG_ESP_CONSOLE_UART_DEFAULT=y
CONFIG_TASK_WDT_PANIC=n
CONFIG_PM_POWER_DOWN_CPU=n
```

## edge-device-stack/esp32/device-sensor/sdkconfig.defaults
```kconfig
CONFIG_IDF_TARGET="esp32c6"
CONFIG_FREERTOS_HZ=1000
CONFIG_WIFI_PROV_SCAN_MAX_ENTRIES=8
CONFIG_ESP_DEFAULT_CPU_FREQ_MHZ=160
CONFIG_COMPILER_OPTIMIZATION_SIZE=y
CONFIG_ESP_SYSTEM_PANIC_PRINT_REBOOT=y
CONFIG_ADC_DISABLE_DAC=y
CONFIG_ESP_CONSOLE_UART_DEFAULT=y
CONFIG_ESP_CONSOLE_UART_BAUDRATE=115200
CONFIG_TASK_WDT_PANIC=n
CONFIG_PM_POWER_DOWN_CPU=n
CONFIG_ESP_SLEEP_POWER_DOWN_FLASH=n
```

## edge-device-stack/esp32/gateway/sdkconfig.defaults
```kconfig
CONFIG_IDF_TARGET="esp32s3"
CONFIG_FREERTOS_HZ=1000
CONFIG_ESP_CONSOLE_NONE=y
CONFIG_ESP_TASK_WDT_INIT=n
CONFIG_WIFI_PROV_SCAN_MAX_ENTRIES=16
CONFIG_ESP_DEFAULT_CPU_FREQ_MHZ=240
CONFIG_COMPILER_OPTIMIZATION_SIZE=y
CONFIG_ESP_SYSTEM_PANIC_PRINT_HALT=y
```
